## camera_test/sdkconfig.defaults
```kconfig
# ESP32 target
CONFIG_IDF_TARGET="esp32"

# Custom partition table (larger app partition for TLS bundle)
CONFIG_PARTITION_TABLE_CUSTOM=y
CONFIG_PARTITION_TABLE_CUSTOM_FILENAME="partitions.csv"
CONFIG_ESPTOOLPY_FLASHSIZE_4MB=y

# PSRAM (required for camera + processing buffers)
CONFIG_SPIRAM=y
CONFIG_SPIRAM_SPEED_80M=y
CONFIG_SPIRAM_USE_MALLOC=y
CONFIG_SPIRAM_MALLOC_ALWAYSINTERNAL=16384
CONFIG_SPIRAM_MALLOC_RESERVE_INTERNAL=32768

# Main task stack
CONFIG_ESP_MAIN_TASK_STACK_SIZE=8192

# Camera sensor support
CONFIG_OV2640_SUPPORT=y

# HTTP server
CONFIG_HTTPD_MAX_REQ_HDR_LEN=1024
CONFIG_HTTPD_MAX_URI_LEN=512

# HTTPS / TLS (for OpenRouter API)
CONFIG_ESP_TLS_USING_MBEDTLS=y
CONFIG_MBEDTLS_CERTIFICATE_BUNDLE=y
CONFIG_MBEDTLS_CERTIFICATE_BUNDLE_DEFAULT_FULL=y

# WPA2-Enterprise (eduroam)
CONFIG_ESP_WIFI_ENTERPRISE_SUPPORT=y
CONFIG_ESP_WIFI_MBEDTLS_TLS_CLIENT=y

# Task watchdog (longer timeout for JPEG encoding + API calls)
CONFIG_ESP_TASK_WDT_TIMEOUT_S=30
```
